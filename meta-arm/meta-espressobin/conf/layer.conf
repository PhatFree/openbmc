## meta-arm/meta-espressobin/conf/layer.conf
```bitbake
# We have a conf and classes directory, add to BBPATH
BBPATH .= ":${LAYERDIR}"

# We have recipes-* directories, add to BBFILES
BBFILES += "${LAYERDIR}/recipes-*/*/*.bb \
            ${LAYERDIR}/recipes-*/*/*.bbappend"

BBFILE_COLLECTIONS += "espressobin-layer"
BBFILE_PATTERN_espressobin-layer := "^${LAYERDIR}/"

#"warrior zeus" means we support yocto 3.0(zeus) & 2.7 "warrior"
LAYERSERIES_COMPAT_espressobin-layer = "warrior zeus"
LAYERVERSION_espressobin-layer = "1"
```

## meta-arm/meta-reference/conf/layer.conf
```bitbake
# We have a conf and classes directory, add to BBPATH
BBPATH .= ":${LAYERDIR}"

# We have recipes-* directories, add to BBFILES
BBFILES += "${LAYERDIR}/recipes-*/*/*.bb \
            ${LAYERDIR}/recipes-*/*/*.bbappend"

BBFILE_COLLECTIONS += "reference-layer"
BBFILE_PATTERN_reference-layer := "^${LAYERDIR}/"
LAYERSERIES_COMPAT_reference-layer = "warrior zeus"
LAYERVERSION_reference-layer = "1"
```

## meta-marvell/conf/layer.conf
```bitbake
# We have a conf and classes directory, add to BBPATH
BBPATH .= ":${LAYERDIR}"

# We have a recipes-* directories, add to BBFILES
BBFILES += "${LAYERDIR}/recipes-*/*/*.bb \
	${LAYERDIR}/recipes-*/*/*.bbappend \
	${LAYERDIR}/classes/*.bbclass \
"

BBFILE_COLLECTIONS += "marvell-layer"
BBFILE_PATTERN_marvell-layer = "^${LAYERDIR}/"

#"warrior zeus" means we support yocto 3.0(zeus) & 2.7 "warrior" 
LAYERSERIES_COMPAT_marvell-layer = "thud warrior zeus"

LAYERDEPENDS_marvell-layer = "core openembedded-layer"
```

## meta-marvell/meta-espressobin/conf/layer.conf
```bitbake
# We have a conf and classes directory, add to BBPATH
BBPATH .= ":${LAYERDIR}"

# We have recipes-* directories, add to BBFILES
BBFILES += "${LAYERDIR}/recipes-*/*/*.bb \
            ${LAYERDIR}/recipes-*/*/*.bbappend"

BBFILE_COLLECTIONS += "espressobin-layer"
BBFILE_PATTERN_espressobin-layer := "^${LAYERDIR}/"
LAYERSERIES_COMPAT_espressobin-layer = "thud warrior zeus"
```
